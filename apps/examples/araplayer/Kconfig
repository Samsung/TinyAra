## apps/examples/araplayer/Kconfig
```kconfig
#
# For a description of the syntax of this configuration file,
# see kconfig-language at https://www.kernel.org/doc/Documentation/kbuild/kconfig-language.txt
#

config EXAMPLES_ARAPLAYER
	bool "AraPlayer example"
	default n
	depends on HAVE_CXX && HAVE_CXXINITIALIZE && MEDIA
	---help---
		Enable the AraPlayer example

config USER_ENTRYPOINT
	string
	default "AraPlayerService_main" if ENTRY_ARAPLAYER
```

## apps/examples/net_local/Kconfig
```kconfig
#
# For a description of the syntax of this configuration file,
# see kconfig-language at https://www.kernel.org/doc/Documentation/kbuild/kconfig-language.txt
#

config EXAMPLES_NET_LOCAL
	bool "Unix Domain Socket example"
	default n

config USER_ENTRYPOINT
	string
	default "net_local_main" if ENTRY_NET_LOCAL
```

## apps/examples/stdk_smart_switch/Kconfig
```kconfig
#
# For a description of the syntax of this configuration file,
# see kconfig-language at https://www.kernel.org/doc/Documentation/kbuild/kconfig-language.txt
#

config EXAMPLES_STDK_SMART_SWITCH
	bool "STDK smart_switch example"
	default n
	depends on STDK_IOT_CORE
	---help---
		Enable the smart switch example of STDK
```

## apps/examples/testcase/le_tc/network/Kconfig
```kconfig
#
# For a description of the syntax of this configuration file,
# see kconfig-language at https://www.kernel.org/doc/Documentation/kbuild/kconfig-language.txt
#

menuconfig EXAMPLES_TESTCASE_NETWORK
	bool "Network TestCase Example"
	default n
	select NET_LWIP_ERROR if NET_LWIP
	---help---
		Enable the Network TestCase Example

if EXAMPLES_TESTCASE_NETWORK

config TC_NET_ALL
	bool "All"
	default n
	select TC_NET_SOCKET
	select TC_NET_PBUF
	select TC_NET_POLL if !DISABLE_POLL
	select TC_NET_SETSOCKOPT
	select TC_NET_CONNECT
	select TC_NET_CLOSE
	select TC_NET_BIND
	select TC_NET_LISTEN
	select TC_NET_GETSOCKNAME
	select TC_NET_GETSOCKOPT
	select TC_NET_FCNTL
	select TC_NET_IOCTL
	select TC_NET_ACCEPT
	select TC_NET_SEND
	select TC_NET_RECV
    select TC_NET_GETPEERNAME
    select TC_NET_SENDTO
    select TC_NET_RECVFROM
    select TC_NET_SHUTDOWN
	select TC_NET_DHCPC
	select TC_NET_SELECT
	select TC_NET_INET
	select TC_NET_ETHER
	select TC_NET_NETDB
	select ITC_NET_CLOSE
	select ITC_NET_LISTEN
	select ITC_NET_SETSOCKOPT
	select ITC_NET_SEND
	select ITC_NET_INET
	select ITC_NET_NETDB
	select ITC_NET_CONNECT

config TC_NET_SOCKET
	bool "socket() api"
	default n

config TC_NET_PBUF
	bool "pbuf() api "
	default n
	select DRIVERS_OS_API_TEST

config TC_NET_POLL
	bool "poll() api"
	default n
	depends on !DISABLE_POLL

config TC_NET_SETSOCKOPT
	bool "setsockopt() api"
	default n

config TC_NET_CONNECT
	bool "connect() api"
	default n

config TC_NET_CLOSE
	bool "close() api"
	default n

config TC_NET_BIND
	bool "bind() api"
	default n

config TC_NET_LISTEN
	bool "listen() api"
	default n

config TC_NET_GETSOCKNAME
	bool "getsockname() api"
	default n

config TC_NET_GETSOCKOPT
	bool "getsockopt() api"
	default n

config TC_NET_FCNTL
	bool "fcntl() api"
	default n

config TC_NET_IOCTL
	bool "ioctl() api"
	default n

config TC_NET_ACCEPT
	bool "accept() api"
	default n

config TC_NET_SEND
	bool "send() api"
	default n

config TC_NET_RECV
	bool "recv() api"
	default n

config TC_NET_GETPEERNAME
	bool "getpeername() api"
	default n

config TC_NET_SENDTO
	bool "sendto() api"
	default n

config TC_NET_RECVFROM
	bool "recvfrom() api"
	default n

config TC_NET_SHUTDOWN
	bool "shutdown() api"
	default n

config TC_NET_DHCPC
	bool "dhcpc() api"
	default n

config TC_NET_INET
	bool "inet() api"
	default n

config TC_NET_ETHER
	bool "ether() api"
	default n

config TC_NET_NETDB
	bool "netdb() api"
	default n

config ITC_NET_CLOSE
	bool "ITC close() api"
	default n

config ITC_NET_LISTEN
	bool "ITC listen() api"
	default n

config ITC_NET_SETSOCKOPT
	bool "ITC setsockopt() api"
	default n

config ITC_NET_SEND
	bool "ITC send() api"
	default n

config ITC_NET_INET
	bool "ITC inet() api"
	default n

config ITC_NET_NETDB
	bool "ITC netdb() api"
	default n

config ITC_NET_CONNECT
	bool "ITC connect() api"
	default n

endif #EXAMPLES_TESTCASE_NETWORK
```

## os/net/bluetooth/Kconfig
```kconfig
#
# For a description of the syntax of this configuration file,
# see kconfig-language at https://www.kernel.org/doc/Documentation/kbuild/kconfig-language.txt
#

config BLUETOOTH
	bool "Enable Bluetooth Subsystem"
	default n
	depends on DRIVERS_BR_EDR && DRIVERS_BLE
	---help---
		Enable Bluetooth Subsystem

if BLUETOOTH

config BLUETOOTH_MAX_CONN
	int
	prompt "Maximum number of simultaneous connections"
	default 1
	range 1 16
	---help---
		Maximum number of simultaneous Bluetooth connections
		supported. The minimum (and default) number is 1.

config BLUETOOTH_MAX_PAIRED
	int
	prompt "Maximum number of paired devices"
	default 1
	range 1 32
	---help---
		Maximum number of paired Bluetooth devices. The minimum (and
		default) number is 1.

config BLUETOOTH_MAXSCANDATA
	int "Max scan data size"
	default 64
	range 1 255
	---help---
		Scan results will be buffered in memory until the user requests the
		scan results.  This parameter specifies the maximum size of the
		advertiser data that accompanies the scan result.

		This contributes to a static memory allocation that will be greater
		than CONFIG_BLUETOOTH_MAXSCANDATA * CONFIG_BLUETOOTH_MAXSCANRESULT

config BLUETOOTH_MAXSCANRESULT
	int "Max scan results"
	default 8
	range 1 255
	---help---
		Scan results will be buffered in memory until the user requests the
		scan results.  This parameter specifies the maximum number of
		results that can be buffered before scan results are lost.

		This contributes to a static memory allocation that will be greater
		than CONFIG_BLUETOOTH_MAXSCANDATA * CONFIG_BLUETOOTH_MAXSCANRESULT

config BLUETOOTH_MAXDISCOVER
	int "Max GATT discovery results"
	default 8
	range 1 255
	---help---
		GATT discovery results will be buffered in memory until the user
		requests the results.  This parameter specifies the maximum results
		that can be buffered before discovery results are lost.

config BLUETOOTH_BUFFER_PREALLOC
	int "Number of pre-allocated buffer structures"
	default 20
	---help---
		This specifies the total number of preallocated buffer structures.
		This is for performance optimization.  If additional buffer structures
		are needed, they will be allocated dynamically at some loss of
		performance.

config BLUETOOTH_BUFFER_IRQRESERVE
	int "Reserved pre-allocated primitive structures"
	default 0
	---help---
		If buffer structures can be allocated from interrupt handlers, then
		this specifies the number of pre-allocated structures that are
		reserved for for use only by interrupt handlers.  This may be set
		zero to reserve no buffers for interrupt handlers. In that case,
		the allocation will fail if tasking logic has allocated them all.

		Interrupt logic will first attempt to allocate from the general,
		pre-allocated buffer pool that will contain up to (size
		CONFIG_BLUETOOTH_BUFFER_PREALLOC - BLUETOOTH_BUFFER_IRQRESERVE)
		entries.  If that fails, then it will try to take a buffer from
		the reserve (size CONFIG_BLUETOOTH_BUFFER_IRQRESERVE).

		Non-interrupt logic will also first attempt to allocate from the
		general, pre-allocated buffer pool.  If that fails, it will
		dynamically allocate the buffer with an additional cost in
		performance.

		NOTE:  The Bluetooth stack never allocates buffers from the
		interrupt level.  This setting only needs to be non-zero if your
		low-level Bluetooth driver needs to do such allocations.

config BT_PRIVACY
	bool "Privacy Feature"
	default n
	---help---
		Enable local Privacy Feature support. This makes it possible
		to use Resolvable Private Addresses (RPAs).

config BT_PHY_UPDATE
	bool "PHY Update"
	default y
	---help---
		Enable support for Bluetooth 5.0 PHY Update Procedure.

config BT_AUTO_PHY_UPDATE
	bool "Auto-initiate PHY Update Procedure"
	depends on BT_PHY_UPDATE
	default y
	---help---
		Initiate PHY Update Procedure on connection establishment.

		Disable this if you want PHY Update Procedure feature supported but
		want to rely on remote device to initiate the procedure at its
		discretion.

config BT_DATA_LEN_UPDATE
	bool "Data Length Update"
	default y
	---help---
		Enable support for Bluetooth v4.2 LE Data Length Update procedure

menu "Kernel Thread Configuration"

config BLUETOOTH_TXCMD_STACKSIZE
	int "Tx command thread stack size"
	default 1024

config BLUETOOTH_TXCMD_PRIORITY
	int "Tx command thread priority"
	default 100
	range 1 255

config BLUETOOTH_TXCMD_NMSGS
	int "Tx command thread mqueue size"
	default 16

config BLUETOOTH_TXCONN_STACKSIZE
	int "Tx connection thread stack size"
	default 1024

config BLUETOOTH_TXCONN_PRIORITY
	int "Tx connection thread priority"
	default 100
	range 1 255

config BLUETOOTH_TXCONN_NMSGS
	int "Tx connection thread mqueue size"
	default 16

endmenu # Kernel Thread Configuration

config BLUETOOTH_SMP_SELFTEST
	bool
	prompt "Bluetooth SMP self tests executed on init"
	default n
	---help---
		This option enables SMP self-tests executed on startup
		to verify security and crypto functions.

menu "Common I/O Buffer Support"

config MM_IOB
	bool "Enable generic I/O buffer support"
	default y
	---help---
		This setting will build the common I/O buffer (IOB) support
		library.

if MM_IOB

config IOB_NBUFFERS
	int "Number of pre-allocated I/O buffers"
	default 24 
	range 8 36
	---help---
		Each packet is represented by a series of small I/O buffers in a
		chain.  This setting determines the number of preallocated I/O
		buffers available for packet data.

config IOB_BUFSIZE
	int "Payload size of one I/O buffer"
	default 196
	---help---
		Each packet is represented by a series of small I/O buffers in a
		chain.  This setting determines the data payload each preallocated
		I/O buffer.

config IOB_NCHAINS
	int "Number of pre-allocated I/O buffer chain heads"
	default 0 if !NET_READAHEAD && !NET_UDP_READAHEAD
	default 8 if NET_READAHEAD || NET_UDP_READAHEAD
	---help---
		These tiny nodes are used as "containers" to support queueing of
		I/O buffer chains.  This will limit the number of I/O transactions
		that can be "in-flight" at any give time.  The default value of
		zero disables this features.

		These generic I/O buffer chain containers are not currently used
		by any logic in NuttX.  That is because their other other specialized
		I/O buffer chain containers that also carry a payload of usage
		specific information.

config IOB_THROTTLE
	int "I/O buffer throttle value"
	default 0 if !NET_WRITE_BUFFERS || !NET_READAHEAD
	default 8 if NET_WRITE_BUFFERS && NET_READAHEAD
	---help---
		TCP write buffering and read-ahead buffer use the same pool of free
		I/O buffers.  In order to prevent uncontrolled incoming TCP packets
		from hogging all of the available, pre-allocated I/O buffers, a
		throttling value is required.  This throttle value assures that
		I/O buffers will be denied to the read-ahead logic before TCP writes
		are halted.

config IOB_DEBUG
	bool "Force I/O buffer debug"
	default n
	depends on DEBUG_FEATURES && !SYSLOG_BUFFER
	---help---
		This option will force debug output from I/O buffer logic.  This
		is not normally something that would want to do but is convenient
		if you are debugging the I/O buffer logic and do not want to get
		overloaded with other un-related debug output.

		NOTE that this selection is not available if IOBs are being used
		to syslog buffering logic (CONFIG_SYSLOG_BUFFER=y)!

endif # MM_IOB
endmenu # Common I/O buffer support
endif # BLUETOOTH
```
